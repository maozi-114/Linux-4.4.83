## drivers/input/touchscreen/hyn/Kconfig
```kconfig
config TOUCHSCREEN_HYNITRON_CST1XX
    tristate "Hynitron CST1xx touchscreen driver"
    depends on I2C && OF
    help
      Say Y here to enable Hynitron CST1xx touchscreen support
      (as used on the GM01 / SL8541E panel).
```

## drivers/video/adf/sprd/Kconfig
```kconfig
config ADF_SPRD
	depends on ADF
	select VIDEOMODE_HELPERS
	select FONT_SUPPORT
	select FONT_8x8
	bool "Enable adf driver for spreadtrum"
	help
	  This driver implements adf core to enable spreadtrum
	  adf support.
source "drivers/video/adf/sprd/drv/Kconfig"
```
